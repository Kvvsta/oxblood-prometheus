## CMakeLists.txt
```
cmake_minimum_required(VERSION 3.20.0)

find_package(Zephyr REQUIRED HINTS $ENV{ZEPHYR_BASE})
project(camera_colour)

FILE(GLOB app_sources src/*.c)
target_sources(app PRIVATE ${app_sources})
```

## Kconfig
```
# SPDX-License-Identifier: Apache-2.0

mainmenu "Oxblood camera colour detection"

menu "Video capture configuration"

config VIDEO_FRAME_HEIGHT
	int "Height of the video frame"
	default 240

config VIDEO_FRAME_WIDTH
	int "Width of the video frame"
	default 240

config VIDEO_PIXEL_FORMAT
	string "Pixel format of the video frame"
	default "RGBP"

config VIDEO_CTRL_VFLIP
	bool "Mirror the video frame vertically"
	default y

endmenu

source "Kconfig.zephyr"
```

## prj.conf
```kconfig
CONFIG_STDOUT_CONSOLE=y
CONFIG_CBPRINTF_FP_SUPPORT=y
CONFIG_NEWLIB_LIBC=y

CONFIG_LOG=y

CONFIG_VIDEO=y
CONFIG_VIDEO_ESP32=y

CONFIG_VIDEO_BUFFER_POOL_SZ_MAX=115200
CONFIG_VIDEO_BUFFER_POOL_NUM_MAX=2
CONFIG_VIDEO_BUFFER_POOL_ALIGN=32
CONFIG_VIDEO_BUFFER_USE_SHARED_MULTI_HEAP=y
CONFIG_VIDEO_BUFFER_SMH_ATTRIBUTE=2

CONFIG_ESP_SPIRAM=y
CONFIG_SPIRAM_MODE_OCT=y

CONFIG_DMA_ESP32_MAX_DESCRIPTOR_NUM=64

CONFIG_DISPLAY=y
CONFIG_ST7789V=y

CONFIG_MAIN_STACK_SIZE=8192

CONFIG_NETWORKING=y
CONFIG_NET_IPV4=y
CONFIG_NET_TCP=y
CONFIG_NET_SOCKETS=y
CONFIG_NET_DHCPV4=y
CONFIG_NET_MGMT=y
CONFIG_NET_MGMT_EVENT=y
CONFIG_NET_MGMT_EVENT_STACK_SIZE=1024
CONFIG_NET_MGMT_EVENT_QUEUE_SIZE=5
CONFIG_NET_PKT_RX_COUNT=16
CONFIG_NET_PKT_TX_COUNT=16
CONFIG_NET_BUF_RX_COUNT=80
CONFIG_NET_BUF_TX_COUNT=80
CONFIG_NET_MAX_CONN=10
CONFIG_NET_MAX_CONTEXTS=10

CONFIG_WIFI=y
CONFIG_WIFI_NM=y
CONFIG_NET_L2_WIFI_MGMT=y

CONFIG_MQTT_LIB=y
CONFIG_MQTT_KEEPALIVE=60
```

## src/main.c
```c
/*
 * Oxblood-Prometheus: Colour Detection
 * references:
 * 		zephyr/samples/drivers/video/capture 
 * 		zephyr/drivers/video/ov2640.c
 */

#include <zephyr/kernel.h>
#include <zephyr/device.h>
#include <zephyr/drivers/video.h>
#include <zephyr/drivers/display.h>
#include <zephyr/logging/log.h>
#include "colour_detect.h"
#include "wifi_mqtt.h"

#define STABLE_FRAMES_ON 4 // 4 consecutive frames to confirm a colour
#define STABLE_FRAMES_OFF 8 // 8 consecutive frames to clear a colour detection.

LOG_MODULE_REGISTER(main, CONFIG_LOG_DEFAULT_LEVEL);

//thread for Wifi connection & MQTT event loop 
static void mqtt_thread_fn(void *a, void *b, void *c)
{
	ARG_UNUSED(a); ARG_UNUSED(b); ARG_UNUSED(c);
	wifi_mqtt_run();
}
// priority 2 -> runs before main so Wifi connects before camera starts
K_THREAD_DEFINE(mqtt_tid, 8192, mqtt_thread_fn, NULL, NULL, NULL, 2, 0, 0);

static int app_setup_video_format(const struct device *const video_dev, struct video_format *const fmt)
{
	int ret;

	ret = video_get_format(video_dev, fmt);
	if (ret < 0) {
		LOG_ERR("video_get_format failed (%d)", ret);
		return ret;
	}

	fmt->width = CONFIG_VIDEO_FRAME_WIDTH;
	fmt->height = CONFIG_VIDEO_FRAME_HEIGHT;
	fmt->pixelformat = VIDEO_PIX_FMT_RGB565;
	fmt->pitch = fmt->width * 2;
	fmt->size = fmt->pitch * fmt->height;

	ret = video_set_format(video_dev, fmt);
	if (ret < 0) {
		LOG_ERR("video_set_format failed (%d)", ret);
		return ret;
	}

	LOG_INF("Camera : %s  %ux%u RGB565",
		video_dev->name, fmt->width, fmt->height);
	return 0;
}

static int app_setup_video_buffers(const struct device *const video_dev, const struct video_caps *const caps,
	const struct video_format *const fmt)
{
	if (caps->min_vbuf_count > CONFIG_VIDEO_BUFFER_POOL_NUM_MAX ||
	    fmt->size > CONFIG_VIDEO_BUFFER_POOL_SZ_MAX) {
		LOG_ERR("Not enough buffers or pool memory");
		return -EINVAL;
	}

	for (int i = 0; i < CONFIG_VIDEO_BUFFER_POOL_NUM_MAX; i++) {
		struct video_buffer *vbuf =
			video_buffer_aligned_alloc(fmt->size,
						   CONFIG_VIDEO_BUFFER_POOL_ALIGN,
						   K_NO_WAIT);
		if (!vbuf) {
			LOG_ERR("Unable to alloc video buffer %d", i);
			return -ENOMEM;
		}

		vbuf->type = VIDEO_BUF_TYPE_OUTPUT;

		int ret = video_enqueue(video_dev, vbuf);
		if (ret < 0) {
			LOG_ERR("Failed to enqueue video buffer %d (%d)", i, ret);
			return ret;
		}
	}
	return 0;
}

static int app_setup_display(const struct device *const display_dev, const struct video_format *const fmt)
{
	if (!device_is_ready(display_dev)) {
		LOG_ERR("Display device not ready");
		return -ENODEV;
	}

	int ret = display_set_pixel_format(display_dev, PIXEL_FORMAT_RGB_565);
	if (ret < 0) {
		LOG_WRN("display_set_pixel_format failed (%d) — continuing", ret);
	}

	display_blanking_off(display_dev);
	LOG_INF("Display: %s  %dx%d",
		display_dev->name, fmt->width, fmt->height);
	return 0;
}

int main(void)
{
	const struct device *const video_dev =
		DEVICE_DT_GET(DT_CHOSEN(zephyr_camera));
	const struct device *const display_dev =
		DEVICE_DT_GET(DT_CHOSEN(zephyr_display));

	struct video_format fmt = { .type = VIDEO_BUF_TYPE_OUTPUT };
	struct video_caps  caps = { .type = VIDEO_BUF_TYPE_OUTPUT };
	struct video_buffer *vbuf = NULL;
	int ret;

	/* Wait for Wifi & MQTT before touching camera 
	 * block here until the mqtt thread has fully connected then start
	 * the camera once Wifi is stable. */
	LOG_INF("Waiting for WiFi & MQTT...");
	wifi_mqtt_wait_ready();
	LOG_INF("WiFi ready - starting camera");

	// setup camera 
	if (!device_is_ready(video_dev)) {
		LOG_ERR("Camera device not ready");
		return -ENODEV;
	}

	ret = app_setup_video_format(video_dev, &fmt);
	if (ret < 0) goto err;

	ret = video_get_caps(video_dev, &caps);
	if (ret < 0) {
		LOG_ERR("video_get_caps failed (%d)", ret);
		goto err;
	}

	ret = app_setup_video_buffers(video_dev, &caps, &fmt);
	if (ret < 0) goto err;

	// setup display
	ret = app_setup_display(display_dev, &fmt);
	if (ret < 0) goto err;

	// start filming
	ret = video_stream_start(video_dev, VIDEO_BUF_TYPE_OUTPUT);
	if (ret < 0) {
		LOG_ERR("video_stream_start failed (%d)", ret);
		goto err;
	}

	LOG_INF("Running - hold a coloured card over the lens");

	colour_t reported_colour = COLOUR_NONE;
	colour_t candidate = COLOUR_NONE;
	int stable_count = 0;
	unsigned int frame = 0;

	const struct display_buffer_descriptor disp_desc = {
		.buf_size = fmt.size,
		.width = fmt.width,
		.height = fmt.height,
		.pitch = fmt.width,
	};

	// filming loop
	while (true) {
		ret = video_dequeue(video_dev, &vbuf, K_FOREVER);
		if (ret < 0) {
			LOG_ERR("video_dequeue failed (%d)", ret);
			goto err;
		}

		frame++;

		// display camera image
		display_write(display_dev, 0, 0, &disp_desc, vbuf->buffer);

		//colour detection
		struct colour_result res;

		colour_detect_verbose((const uint8_t *)vbuf->buffer, (uint32_t)fmt.width, (uint32_t)fmt.height, &res);

		// return buffer to camera
		ret = video_enqueue(video_dev, vbuf);
		if (ret < 0) {
			LOG_ERR("video_enqueue failed (%d)", ret);
			goto err;
		}

		// check the number of frames the currrent candiate has been seen for
		if (res.colour == candidate) {
			stable_count++;
		} else {
			candidate = res.colour;
			stable_count = 1;
		}

		int threshold = (candidate == COLOUR_NONE) ? STABLE_FRAMES_OFF : STABLE_FRAMES_ON;

		if (stable_count >= threshold &&
		    candidate != reported_colour) {
			float pct = (res.total > 0) ? (float)res.votes[candidate] / (float)res.total * 100.0f : 0.0f;

			LOG_INF("[%4u] -> %-8s  H:%5.1f S:%.2f V:%.2f  (%2.0f%%)",
				frame, colour_name(candidate),
				(double)res.avg_h,
				(double)res.avg_s,
				(double)res.avg_v,
				(double)pct);

			reported_colour = candidate;
			wifi_mqtt_publish_colour(reported_colour);
		}
	}

err:
	LOG_ERR("Aborting");
	return ret;
}
```

## src/colour_detect.c
```c
/*
 * colour_detect.c -> HSV majority vote 
 *
 * only the centre SAMPLE_SIZE×SAMPLE_SIZE region is examined.
 *
 * Target colours:
 *   Orange H = roughly 27 degrees (15–45 degreees) (british paints wordly YEL 119 paint sample card)
 *   Purple H = roughly 233 degrees (210–260 degrees) (british paints royal tuplip EB 252 paint sample card)
 *   Red H = roughly 2 degrees (345–360 degrees and 0–15 degrees)  (british paints red bauble RED 186 paint sample card)
 */

#include <math.h>
#include <stddef.h>
#include <zephyr/sys/util.h>
#include "colour_detect.h"

#define DEG2RAD (3.14159265f / 180.f)
#define RAD2DEG (180.f / 3.14159265f)

#define SAMPLE_SIZE 20  // side length of centre region in pixels
#define MIN_SATURATION 0.22f // below this is grey/colourless
#define MIN_VALUE 0.12f  // below this is too dark
#define VOTE_THRESHOLD 0.50f  // fraction of pixels that must vote to agree 

// HSV thresholds 
#define HUE_ORANGE_LO 15.0f
#define HUE_ORANGE_HI 45.0f
#define HUE_PURPLE_LO 210.0f
#define HUE_PURPLE_HI 260.0f
//red wraps around 0degrees: 345–360degrees and 0–HUE_ORANGE_LO 

/*
 * The OV2640 via the ESP32 DVP stores RGB565 big-endian (high byte — RRRRRGGG — at the lower address).  
 * On the little-endian ESP32, casting two consecutive bytes to uint16_t reverses them.  
 * Undo that swap before extracting channels.
 */
static inline void rgb565_unpack(uint16_t px, uint8_t *r, uint8_t *g, uint8_t *b)
{
    px = (uint16_t)((px >> 8) | (px << 8));
    *r = (uint8_t)(((px >> 11) & 0x1Fu) * 255u / 31u);
    *g = (uint8_t)(((px >> 5) & 0x3Fu) * 255u / 63u);
    *b = (uint8_t)(( px & 0x1Fu) * 255u / 31u);
}

// RGB -> HSV 
static void rgb_to_hsv(uint8_t r, uint8_t g, uint8_t b, float *h, float *s, float *v)
{
    float rf = (float)r / 255.0f;
    float gf = (float)g / 255.0f;
    float bf = (float)b / 255.0f;

    float cmax = MAX(MAX(rf, gf), bf);
    float cmin = MIN(MIN(rf, gf), bf);
    float delta = cmax - cmin;

    *v = cmax;
    *s = (cmax < 0.001f) ? 0.0f : (delta / cmax);

    if (delta < 0.001f) {
        *h = 0.0f;
    } else if (cmax == rf) {
        *h = 60.0f * fmodf((gf - bf) / delta, 6.0f);
    } else if (cmax == gf) {
        *h = 60.0f * ((bf - rf) / delta + 2.0f);
    } else {
        *h = 60.0f * ((rf - gf) / delta + 4.0f);
    }

    if (*h < 0.0f) {
        *h += 360.0f;
    }
}

// pixel classifier based on HSV thresholds
static colour_t classify_pixel(float h, float s, float v)
{
    if (s < MIN_SATURATION || v < MIN_VALUE) {
        return COLOUR_NONE;
    }

    if (h >= 345.0f || h < HUE_ORANGE_LO) return COLOUR_RED;
    if (h >= HUE_ORANGE_LO && h < HUE_ORANGE_HI) return COLOUR_ORANGE;
    if (h >= HUE_PURPLE_LO && h < HUE_PURPLE_HI) return COLOUR_PURPLE;

    return COLOUR_NONE;
}


colour_t colour_detect_verbose(const uint8_t *buf, uint32_t width, uint32_t height, struct colour_result *out)
{
    const uint16_t *pixels = (const uint16_t *)buf;

    int cx = (int)width / 2;
    int cy = (int)height / 2;
    int half = SAMPLE_SIZE / 2;

    int votes[4] = {0, 0, 0, 0};

    // sin/cos accumulators used to calculate circular-mean of hue for each colour
    // this avoids wrap bias caused by red wrapping around the 0 & 360 degree boundary.
    float h_sin[4] = {0.f, 0.f, 0.f, 0.f};
    float h_cos[4] = {0.f, 0.f, 0.f, 0.f};
    float s_sum[4] = {0.f, 0.f, 0.f, 0.f};
    float v_sum[4] = {0.f, 0.f, 0.f, 0.f};
    int total = 0;

    // extract the centre pixel for debugging 
    uint8_t ctr_r = 0, ctr_g = 0, ctr_b = 0;
    rgb565_unpack(pixels[cy * (int)width + cx], &ctr_r, &ctr_g, &ctr_b);

    for (int y = cy - half; y < cy + half; y++) {
        for (int x = cx - half; x < cx + half; x++) {
            uint16_t px = pixels[y * (int)width + x];
            uint8_t r, g, b;
            rgb565_unpack(px, &r, &g, &b);

            float h, s, v;
            rgb_to_hsv(r, g, b, &h, &s, &v);

            colour_t c = classify_pixel(h, s, v);
            votes[c]++;
            // circular mean again
            h_sin[c] += sinf(h * DEG2RAD);
            h_cos[c] += cosf(h * DEG2RAD);
            s_sum[c] += s;
            v_sum[c] += v;
            total++;
        }
    }

    colour_t best = COLOUR_NONE;
    int best_count = 0;

    for (int i = 1; i < 4; i++) {
        if (votes[i] > best_count) {
            best_count = votes[i];
            best = (colour_t)i;
        }
    }

    bool pass = (total > 0) && ((float)best_count / (float)total >= VOTE_THRESHOLD) && (best != COLOUR_NONE);

    colour_t result = pass ? best : COLOUR_NONE;

    if (out) {
        out->colour   = result;
        for (int i = 0; i < 4; i++) {
            out->votes[i] = votes[i];
        }
        out->total = total;
        // report HSV averages only for the winning colour
        colour_t bucket = (result != COLOUR_NONE) ? result : COLOUR_NONE;
        int bv = votes[bucket];
        if (bv > 0) {
            // circular mean again
            float ch = atan2f(h_sin[bucket] / bv, h_cos[bucket] / bv) * RAD2DEG;
            if (ch < 0.f) ch += 360.f;
            out->avg_h = ch;
        } else {
            out->avg_h = 0.f;
        }
        out->avg_s = (bv > 0) ? s_sum[bucket] / (float)bv : 0.f;
        out->avg_v = (bv > 0) ? v_sum[bucket] / (float)bv : 0.f;
        out->center_r = ctr_r;
        out->center_g = ctr_g;
        out->center_b = ctr_b;
    }

    return result;
}

const char *colour_name(colour_t c)
{
    switch (c) {
        case COLOUR_ORANGE: return "ORANGE";
        case COLOUR_PURPLE: return "PURPLE";
        case COLOUR_RED: return "RED";
        default: return "NONE";
    }
}
```

## src/colour_detect.h
```c
#ifndef COLOUR_DETECT_H
#define COLOUR_DETECT_H

#include <stdint.h>

typedef enum {
    COLOUR_NONE,
    COLOUR_ORANGE,
    COLOUR_PURPLE,
    COLOUR_RED,
} colour_t;

struct colour_result {
    colour_t colour;  // final verdict of colour
    int votes[4];   // vote counts for each colour            
    int total;   // total pixels sampled                      
    float avg_h; // average hue: over winning colour pixels only
    float avg_s;  // average sat 
    float avg_v;  // average value  

    //center pixel — raw extracted channels for byte-order diagnostics  
    uint8_t center_r;
    uint8_t center_g;
    uint8_t center_b;
};

colour_t colour_detect_verbose(const uint8_t *buf, uint32_t width, uint32_t height, struct colour_result *out);

const char *colour_name(colour_t c);

#endif /* COLOUR_DETECT_H */
```

## src/wifi_mqtt.c
```c
/*
 * wifi_mqtt.c — Wifi connection & MQTT publisher for Zephyr
 *
 *   Connects to the configured WiFi though WPA2-PSK
 *      then waits for DHCP to assign an address
 *      then establishes an MQTT
 * 
 *   References: 
 *      zephyr/samples/net/mqtt_publisher
 */

#include <zephyr/kernel.h>
#include <zephyr/net/net_if.h>
#include <zephyr/net/net_mgmt.h>
#include <zephyr/net/wifi_mgmt.h>
#include <zephyr/net/mqtt.h>
#include <zephyr/net/socket.h>
#include <zephyr/logging/log.h>
#include <string.h>
#include <errno.h>
#include "wifi_mqtt.h"
#include "colour_detect.h"

LOG_MODULE_REGISTER(wifi_mqtt, LOG_LEVEL_INF);

// my wifi hotspot name and password and details
#define WIFI_SSID "Yo"
#define WIFI_PASSWORD "deeznuts"
#define MQTT_BROKER_IP "172.20.10.5"
// broker details
#define MQTT_PORT 1883
#define MQTT_TOPIC "prometheus/gesture"
#define MQTT_CLIENT_ID "prometheus-camera-zephyr"
#define MQTT_BUFFER_SIZE 256
#define CONNECT_TIMEOUT_MS 2000
#define CONNECT_TRIES 10


static struct mqtt_client      client_ctx;
static struct sockaddr_storage broker;
static uint8_t                 rx_buf[MQTT_BUFFER_SIZE];
static uint8_t                 tx_buf[MQTT_BUFFER_SIZE];

static struct zsock_pollfd fds[1];
static int                 nfds;
static bool          mqtt_connected;

static K_SEM_DEFINE(wifi_connected_sem, 0, 1);
static K_SEM_DEFINE(mqtt_ready_sem, 0, 1);
static K_MUTEX_DEFINE(publish_mutex);

// Wifi event callback
static struct net_mgmt_event_callback wifi_mgmt_cb;

static void wifi_mgmt_event_handler(struct net_mgmt_event_callback *cb, uint64_t mgmt_event, struct net_if *iface)
{
    ARG_UNUSED(cb);
    ARG_UNUSED(iface);

    if (mgmt_event == NET_EVENT_WIFI_CONNECT_RESULT) {
        const struct wifi_status *status =
            (const struct wifi_status *)cb->info;

        if (status->status == 0) {
            LOG_INF("WiFi associated");
            k_sem_give(&wifi_connected_sem);
        } else {
            LOG_ERR("WiFi connect failed (status %d)", status->status);
        }
    }
}

static void wifi_connect(void)
{
    struct net_if *iface = net_if_get_default();

    net_mgmt_init_event_callback(&wifi_mgmt_cb, wifi_mgmt_event_handler, NET_EVENT_WIFI_CONNECT_RESULT);
    net_mgmt_add_event_callback(&wifi_mgmt_cb);

    struct wifi_connect_req_params params = {
        .ssid = (const uint8_t *)WIFI_SSID,
        .ssid_length = strlen(WIFI_SSID),
        .psk = (const uint8_t *)WIFI_PASSWORD,
        .psk_length = strlen(WIFI_PASSWORD),
        .channel = WIFI_CHANNEL_ANY,
        .security = WIFI_SECURITY_TYPE_PSK,
    };

    LOG_INF("Requesting WiFi connect: %s", WIFI_SSID);

    int ret = net_mgmt(NET_REQUEST_WIFI_CONNECT, iface, &params, sizeof(params));
    if (ret < 0) {
        LOG_ERR("WiFi connect request failed (%d)", ret);
    }
}

static void wait_for_network(void)
{
    wifi_connect();

    // block until Wifi connectyion succeeds
    k_sem_take(&wifi_connected_sem, K_FOREVER);

    // give DHCP time to assign an address.
    LOG_INF("WiFi up — waiting 3 s for DHCP...");
    k_sleep(K_SECONDS(3));
    LOG_INF("Network ready");
}

// mqtt event handler
static void mqtt_evt_handler(struct mqtt_client *client, const struct mqtt_evt *evt)
{
    switch (evt->type) {
    case MQTT_EVT_CONNACK:
        if (evt->result != 0) {
            LOG_ERR("MQTT CONNACK error %d", evt->result);
            break;
        }
        mqtt_connected = true;
        LOG_INF("MQTT connected to %s:%d", MQTT_BROKER_IP, MQTT_PORT);
        k_sem_give(&mqtt_ready_sem); // unblock main -> camera can now start 
        break;

    case MQTT_EVT_DISCONNECT:
        LOG_INF("MQTT disconnected (%d)", evt->result);
        mqtt_connected = false;
        nfds = 0;
        break;

    case MQTT_EVT_PUBACK:
    case MQTT_EVT_PUBLISH:
        break;

    default:
        break;
    }
}

// mqtt broker initialisation 
static void broker_init(void)
{
    struct sockaddr_in *broker4 = (struct sockaddr_in *)&broker;

    broker4->sin_family = AF_INET;
    broker4->sin_port = htons(MQTT_PORT);
    net_addr_pton(AF_INET, MQTT_BROKER_IP, &broker4->sin_addr);
}

// mqtt client initialisation from mqtt_publisher sample
static void client_init(struct mqtt_client *client)
{
    mqtt_client_init(client);

    broker_init();

    client->broker           = &broker;
    client->evt_cb           = mqtt_evt_handler;
    client->client_id.utf8   = (uint8_t *)MQTT_CLIENT_ID;
    client->client_id.size   = strlen(MQTT_CLIENT_ID);
    client->password         = NULL;
    client->user_name        = NULL;
    client->protocol_version = MQTT_VERSION_3_1_1;
    client->rx_buf           = rx_buf;
    client->rx_buf_size      = sizeof(rx_buf);
    client->tx_buf           = tx_buf;
    client->tx_buf_size      = sizeof(tx_buf);
    client->transport.type   = MQTT_TRANSPORT_NON_SECURE;
}

//poll helpers from mqtt_publisher sample
static void prepare_fds(struct mqtt_client *client)
{
    fds[0].fd = client->transport.tcp.sock;
    fds[0].events = ZSOCK_POLLIN;
    nfds = 1;
}

static int do_poll(int timeout_ms)
{
    if (nfds <= 0) {
        return 0;
    }
    int ret = zsock_poll(fds, nfds, timeout_ms);
    if (ret < 0) {
        LOG_ERR("poll error: %d", errno);
    }
    return ret;
}

// retry conenction from mqtt_publisher sample 
static int try_to_connect(void)
{
    int rc;

    for (int i = 0; i < CONNECT_TRIES && !mqtt_connected; i++) {
        client_init(&client_ctx);

        rc = mqtt_connect(&client_ctx);
        if (rc != 0) {
            LOG_ERR("mqtt_connect failed (%d), try %d/%d",
                    rc, i + 1, CONNECT_TRIES);
            k_sleep(K_MSEC(500));
            continue;
        }

        prepare_fds(&client_ctx);

        if (do_poll(CONNECT_TIMEOUT_MS)) {
            mqtt_input(&client_ctx);
        }

        if (!mqtt_connected) {
            mqtt_abort(&client_ctx);
        }
    }

    return mqtt_connected ? 0 : -ETIMEDOUT;
}

// block until WIFI & MQTT are ready
void wifi_mqtt_wait_ready(void)
{
    k_sem_take(&mqtt_ready_sem, K_FOREVER);
}

// infinite WIFI & MQTTloop 
void wifi_mqtt_run(void)
{
    wait_for_network();

    while (true) {
        if (!mqtt_connected) {
            LOG_INF("Connecting to MQTT broker...");
            if (try_to_connect() < 0) {
                LOG_ERR("MQTT connect failed — retry in 5 s");
                k_sleep(K_SECONDS(5));
                continue;
            }
        }

        int ret = do_poll(mqtt_keepalive_time_left(&client_ctx));
        if (ret > 0 && (fds[0].revents & ZSOCK_POLLIN)) {
            mqtt_input(&client_ctx);
        }
        mqtt_live(&client_ctx);
    }
}

//publish colour to MQTT 
void wifi_mqtt_publish_colour(colour_t c)
{
    if (!mqtt_connected) {
        return;
    }

    const char *cmd;
    switch (c) {
    case COLOUR_RED: cmd = "START"; break;
    case COLOUR_ORANGE: cmd = "PAUSE"; break;
    case COLOUR_PURPLE: cmd = "RESTART"; break;
    default: return; // COLOUR_NONE -> nothing to send 
    }

    struct mqtt_publish_param p = {
        .message = {
            .topic = {
                .qos = MQTT_QOS_0_AT_MOST_ONCE,
                .topic = {.utf8 = (uint8_t *)MQTT_TOPIC, .size = strlen(MQTT_TOPIC)},
            },
            .payload = {
                .data = (uint8_t *)cmd,
                .len = (uint32_t)strlen(cmd),
            },
        },
        .message_id = 0,
        .dup_flag = 0,
        .retain_flag = 0,
    };

    k_mutex_lock(&publish_mutex, K_FOREVER);
    int ret = mqtt_publish(&client_ctx, &p);
    k_mutex_unlock(&publish_mutex);

    if (ret < 0) {
        LOG_ERR("mqtt_publish failed (%d)", ret);
    } else {
        LOG_INF("Published: %s", cmd);
    }
}
```

## src/wifi_mqtt.h
```c
#ifndef WIFI_MQTT_H
#define WIFI_MQTT_H

#include "colour_detect.h"

void wifi_mqtt_run(void);
void wifi_mqtt_publish_colour(colour_t c);
void wifi_mqtt_wait_ready(void);

#endif /* WIFI_MQTT_H */
```
