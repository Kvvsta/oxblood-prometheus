## CMakeLists.txt
```
cmake_minimum_required(VERSION 3.20.0)

find_package(Zephyr REQUIRED HINTS $ENV{ZEPHYR_BASE})

project(base_node)

target_sources(app PRIVATE
    src/main.c
    src/nus_client.c
    src/mobile_link.c
    src/json_serial.c
    src/serial_audio.c
    src/audio_out.c
    src/ui_display.c
)
```

## prj.conf
```kconfig
CONFIG_BT=y
CONFIG_BT_CENTRAL=y
CONFIG_BT_GATT_CLIENT=y
CONFIG_BT_MAX_CONN=2
CONFIG_BT_MAX_PAIRED=2
CONFIG_BT_DEVICE_NAME="OXBLOOD-BASE"

CONFIG_SERIAL=y
CONFIG_CONSOLE=y
CONFIG_UART_CONSOLE=y
CONFIG_PRINTK=y
CONFIG_UART_INTERRUPT_DRIVEN=y
CONFIG_SHELL=n
CONFIG_SHELL_BACKEND_SERIAL=n
CONFIG_KERNEL_SHELL=n

CONFIG_DISPLAY=y
CONFIG_LVGL=y
CONFIG_MAIN_STACK_SIZE=8192
CONFIG_LV_Z_MEM_POOL_SIZE=32768
CONFIG_LV_Z_AUTO_INIT=y

CONFIG_I2S=y

CONFIG_NEWLIB_LIBC=y
CONFIG_NEWLIB_LIBC_FLOAT_PRINTF=y
CONFIG_CBPRINTF_FP_SUPPORT=y
```

## boards/m5stack_core2_esp32_procpu.overlay
```dts
#include <zephyr/dt-bindings/pinctrl/esp32-pinctrl.h>

&i2s0 {
	status = "okay";
	pinctrl-0 = <&i2s0_default>;
	pinctrl-names = "default";
};

&pinctrl {
	i2s0_default: i2s0_default {
		group1 {
			pinmux = <
				I2S0_O_BCK_GPIO12
				I2S0_O_WS_GPIO0
				I2S0_O_SD_GPIO2
			>;
		};
	};
};
```

## src/main.c
```c
#include "nus_client.h"
#include "json_serial.h"
#include "mobile_link.h"
#include "serial_audio.h"
#include "audio_out.h"
#include "ui_display.h"

#include <zephyr/kernel.h>
#include <zephyr/bluetooth/bluetooth.h>
#include <zephyr/sys/printk.h>

int main(void) {

    int err;

    k_sleep(K_SECONDS(2));
    
    printk("BASE BOOTED\n");

    json_serial_init();
    ui_display_init();
    mobile_link_start();
    audio_out_init();
    serial_init();

    // Enable bluetooth stack 
    err = bt_enable(NULL);
    if (err) {
        printk("{\"type\":\"status\",\"status\":\"bt_enable_failed\","
		       "\"err\":%d}\n",
		       err);
		return 0;
    }

    json_emit_status("bluetooth", "ready"); // Bluetooth ready status

    // Initialise and start base scanning/conneting to mobile nodes
    nus_client_init();
    (void)nus_client_start();
        
    while (1) {
        // m5core LVGL updated regularly 
        ui_display_tick();
        k_sleep(K_MSEC(10));
    }

    return 0;
}
```

## src/audio_out.c
```c
#include "audio_out.h"
#include "json_serial.h"

#include <zephyr/kernel.h>
#include <zephyr/device.h>
#include <zephyr/drivers/i2s.h>
#include <math.h>
#include <string.h>
#include <stdint.h>

#define SAMPLE_RATE_HZ 16000
#define TONE_MS 120
#define CHANNELS 2
#define BLOCK_FRAMES 256
#define BLOCK_SIZE (BLOCK_FRAMES * CHANNELS * sizeof(int16_t))
#define BLOCK_COUNT 12
#define TOTAL_FRAMES ((SAMPLE_RATE_HZ * TONE_MS) / 1000)
#define I2S_NODE DT_NODELABEL(i2s0)
#define AUDIO_EVENT_MAX_LEN 24
#define AUDIO_QUEUE_LEN 4
#define AUDIO_STACK_SIZE 2048
#define AUDIO_PRIORITY 10

K_MSGQ_DEFINE(audio_msgq, AUDIO_EVENT_MAX_LEN, AUDIO_QUEUE_LEN, 4);

static void audio_thread(void *a, void *b, void *c);
K_THREAD_DEFINE(audio_tid, AUDIO_STACK_SIZE, audio_thread, NULL, NULL, NULL,
                AUDIO_PRIORITY, 0, 0);

/* 
 * I2S DMA buffers are in non-cache memory on ESP32.
 * Each slab block holds one stereo audio block.
 */
K_MEM_SLAB_DEFINE_IN_SECT_STATIC(i2s_mem_slab, __nocache, BLOCK_SIZE, BLOCK_COUNT, 4);

static const struct device *i2s_dev = DEVICE_DT_GET_OR_NULL(I2S_NODE);

/*
 * Public non-blocking API.
 * Other files call this to request an audio event.
 */
void audio_out_queue_event(const char* event) {
    char msg[AUDIO_EVENT_MAX_LEN] = {0};

    if (!event) {
        return;
    }

    strncpy(msg, event, sizeof(msg) - 1);

    if (k_msgq_put(&audio_msgq, msg, K_NO_WAIT) != 0) {
        json_emit_status("audio", "audio queue full");
    }
}

/*
 * Dedicated audio thread.
 * Prevents I2S playback from blocking UART/BLE/game data handling.
 */
static void audio_thread(void* a, void* b, void* c) {

    char event[AUDIO_EVENT_MAX_LEN];

    while (1) {
        k_msgq_get(&audio_msgq, event, K_FOREVER);
        audio_out_play_event(event);
    }
}

/*
 * Fill one stereo I2S block.
 *
 * freq_hz > 0: generate sine tone.
 * freq_hz <= 0: generate silence.
 */
static void fill_tone_block(int16_t *buf, int freq_hz, int start_frame, int frames) {
	for (int i = 0; i < frames; i++) {

		int16_t sample = 0;

		if (freq_hz > 0) {
			float t = (float)(start_frame + i) / (float)SAMPLE_RATE_HZ;
			float s = sinf(2.0f * 3.1415926f * (float)freq_hz * t);
			sample = (int16_t)(s * 12000.0f);
		}

		buf[2 * i] = sample;
		buf[2 * i + 1] = sample;
	}

	// Zero pad unused part of block 
	for (int i = frames; i < BLOCK_FRAMES; i++) {
		buf[2 * i] = 0;
		buf[2 * i + 1] = 0;
	}
}

/*
 * Play a sequence of tone blocks.
 *
 * Each entry in freqs[] lasts:
 *     BLOCK_FRAMES / SAMPLE_RATE_HZ = 256 / 16000 = 16 ms.
 *
 * Example:
 *     {260, 260, 0, 180, 180}
 * gives two high blocks, one silent block, two lower blocks.
 */
static void play_tone_sequence(const int *freqs, int count) {
	bool started = false;

	for (int i = 0; i < count; i++) {
		void *tx_block;

		int err = k_mem_slab_alloc(&i2s_mem_slab, &tx_block, K_FOREVER);
		if (err) {
			json_emit_status("audio", "i2s slab alloc failed");
			break;
		}

		fill_tone_block((int16_t *)tx_block, freqs[i], 0, BLOCK_FRAMES);

		err = i2s_write(i2s_dev, tx_block, BLOCK_SIZE);
		if (err) {
			k_mem_slab_free(&i2s_mem_slab, tx_block);
			json_emit_status("audio", "i2s write failed");
			break;
		}

		if (!started) {
			err = i2s_trigger(i2s_dev, I2S_DIR_TX, I2S_TRIGGER_START);
			if (err) {
				json_emit_status("audio", "i2s start failed");
				break;
			}
			started = true;
		}
	}

	// DRAIN lets queued audio finish before next in queue 
	if (started) {
		(void)i2s_trigger(i2s_dev, I2S_DIR_TX, I2S_TRIGGER_DRAIN);
	}
}

/*
 * Configure the I2S peripheral once at startup.
 */
void audio_out_init(void) {
	if (!i2s_dev || !device_is_ready(i2s_dev)) {
		json_emit_status("audio", "i2s device not ready");
		return;
	}

	struct i2s_config config = {
		.word_size = 16,
		.channels = 2,
		.format = I2S_FMT_DATA_FORMAT_I2S,
		.options = I2S_OPT_FRAME_CLK_MASTER | I2S_OPT_BIT_CLK_MASTER,
		.frame_clk_freq = SAMPLE_RATE_HZ,
		.mem_slab = &i2s_mem_slab,
		.block_size = BLOCK_SIZE,
		.timeout = 1000,
	};

	int err = i2s_configure(i2s_dev, I2S_DIR_TX, &config);

	if (err) {
		json_emit_status("audio", "i2s configure failed");
		return;
	}

	json_emit_status("audio", "m5 core2 i2s audio ready");
}

/*
 * Convert game events into sound effects.
 */
void audio_out_play_event(const char *event)
{
	if (!i2s_dev || !device_is_ready(i2s_dev)) {
		json_emit_status("audio", "i2s not ready");
		return;
	}

	if (!event) {
		return;
	}

	if (strcmp(event, "eagle_killed") == 0) {
		// Eagle killed sound effect
		static const int eagle_freqs[] = {
			1400,
			1800,
			2400,
			3200,
			3800,
			3400,
			3900,
			3200,
			2600,
			2100,
			1700
		};

		json_emit_audio_debug("eagle_killed", "eagle_screech");
		play_tone_sequence(eagle_freqs, ARRAY_SIZE(eagle_freqs));
		return;
	} else if (strcmp(event, "game_over") == 0) {
		// Game over sound effect 
		static const int game_over_freqs[] = {
			260, 260, 260, 260,
			0, 0,
			180, 180, 180, 180
		};

		json_emit_audio_debug("game_over", "duh_duh");
		play_tone_sequence(game_over_freqs, ARRAY_SIZE(game_over_freqs));
		return;
	} else {
		json_emit_audio_debug(event, "ignored_unknown_audio_event");
		return;
	}
}
```

## src/audio_out.h
```c
#ifndef AUDIO_OUT_H
#define AUDIO_OUT_H

void audio_out_init(void);
void audio_out_play_event(const char *event);
void audio_out_queue_event(const char *event);

#endif
```

## src/imu_packet.h
```c
#ifndef IMU_PACKET_H
#define IMU_PACKET_H

#include <stdint.h>
#include <zephyr/sys/util.h>

struct imu_packet {
    int32_t gy;
    int32_t gz;
} __packed;

#endif
```

## src/json_serial.c
```c
#include "json_serial.h"
#include "mobile_link.h"

#include <zephyr/sys/printk.h>
#include <string.h>

/*
 * Initialise JSON serial output.
 *
 * Emits a startup message confirming the serial JSON interface is ready.
 */
void json_serial_init(void)
{
    printk("{\"status\":\"json_serial_ready\"}\n");
}

/*
 * Emit one IMU record to PC.
 *
 * Output format matches what liver_backend.py and game.js expect:
 *   {"player":1,"gy":1.234567,"gz":-0.678901}
 */
void json_emit_imu(const char* node_name, float gyro_y, float gyro_z)
{
    int player = -1; 
    
    if (strcmp(node_name, "PROMETHEUS-P1") == 0) {
        player = 1;

    } else if (strcmp(node_name, "PROMETHEUS-P2") == 0){
        player = 2; 
    } else {
        json_emit_status("imu_packet_error", "unknown player node");
        return;
    }

    printk("{\"player\":%d,\"gy\":%.4f,\"gz\":%.4f}\n",
           player,
           (double)gyro_y,
           (double)gyro_z);
}

/*
 * Emit a simple status/debug message.
 */
void json_emit_status(const char *status, const char *detail)
{
    printk("{\"type\":\"status\",\"status\":\"%s\",\"detail\":\"%s\"}\n",
           status ? status : "unknown",
           detail ? detail : "");
}

/*
 * Emit an audio debug message.
 */
void json_emit_audio_debug(const char *event, const char *action)
{
    printk("{\"type\":\"audio_debug\",\"event\":\"%s\",\"action\":\"%s\"}\n",
           event ? event : "unknown",
           action ? action : "unknown");
}
```

## src/json_serial.h
```c
#ifndef JSON_SERIAL_H
#define JSON_SERIAL_H

#include <stdint.h>

void json_serial_init(void);
void json_emit_imu(const char* node_name, float gyro_y, float gyro_z);
void json_emit_status(const char *status, const char *detail);
void json_emit_audio_debug(const char *event, const char *action);

#endif /* JSON_SERIAL_H */
```

## src/mobile_link.c
```c
#include "mobile_link.h"
#include "json_serial.h"
#include "ui_display.h"

#include <zephyr/kernel.h>

#include <stdbool.h>
#include <stdint.h>
#include <string.h>

static int64_t last_ui_update_ms;

/*
 * Emit a startup status message.
 */
void mobile_link_start(void)
{
    json_emit_status("mobile_link", "ready");
}

/*
 * Process one packed IMU packet from a mobile node and emit JSON to serial.
 *
 * Extracts the player number from the last character of node_name
 * e.g. "PROMETHEUS-P1" -> player 1.
 */
bool mobile_link_process_imu_packet(const char *node_name,
				    const struct imu_packet *pkt, size_t len)
{
    if (!node_name || !pkt) {
        return false;
    }

    if (len != sizeof(struct imu_packet)) {
        json_emit_status("imu_packet_error", "invalid packet length");
        return false;
    }

    float gyro_y = (float)pkt->gy / 1000000.0f;
    float gyro_z = (float)pkt->gz / 1000000.0f;

    int player = -1;

    if (strcmp(node_name, "PROMETHEUS-P1") == 0) {
        player = 1;
    } else if (strcmp(node_name, "PROMETHEUS-P2") == 0) {
        player = 2;
    }

    int64_t now = k_uptime_get();

    if (player > 0 && now - last_ui_update_ms >= 200) {
        ui_display_update_imu(player, gyro_y, gyro_z);
        last_ui_update_ms = now;
    }

    json_emit_imu(node_name, gyro_y, gyro_z);

    return true;
}
```

## src/mobile_link.h
```c
#ifndef MOBILE_LINK_H
#define MOBILE_LINK_H

#include <stdbool.h>
#include <stddef.h>
#include "imu_packet.h"

void mobile_link_start(void);
bool mobile_link_process_imu_packet(const char *node_name, const struct imu_packet *pkt,
        size_t len);

#endif /* MOBILE_LINK_H */
```

## src/nus_client.c
```c
#include "nus_client.h"
#include "mobile_link.h"
#include "json_serial.h"
#include "imu_packet.h"

#include <stddef.h>
#include <errno.h>
#include <stdint.h>
#include <string.h>

#include <zephyr/types.h>
#include <zephyr/kernel.h>
#include <zephyr/sys/printk.h>

#include <zephyr/bluetooth/att.h>
#include <zephyr/bluetooth/bluetooth.h>
#include <zephyr/bluetooth/hci.h>
#include <zephyr/bluetooth/conn.h>
#include <zephyr/bluetooth/uuid.h>
#include <zephyr/bluetooth/gatt.h>

#define NUM_MOBILE_NODES 2


static const char* const mobile_names[NUM_MOBILE_NODES] = {
    "PROMETHEUS-P1",
    "PROMETHEUS-P2",
};

static const struct bt_le_conn_param fast_conn_params = {
	.interval_min = 16,
	.interval_max = 16,
	.latency = 0,
	.timeout = 400,
};

/*
 * Nordic UART Service UUIDs.

 */
#define BT_UUID_NUS_SERVICE_VAL \
    BT_UUID_128_ENCODE(0x6E400001, 0xB5A3, 0xF393, 0xE0A9, 0xE50E24DCCA9E)

#define BT_UUID_NUS_TX_VAL \
    BT_UUID_128_ENCODE(0x6E400003, 0xB5A3, 0xF393, 0xE0A9, 0xE50E24DCCA9E)

#define BT_UUID_NUS_SERVICE BT_UUID_DECLARE_128(BT_UUID_NUS_SERVICE_VAL)
#define BT_UUID_NUS_TX      BT_UUID_DECLARE_128(BT_UUID_NUS_TX_VAL)

/*
 * Static CCC UUID with program lifetime.
 *
 * BT_UUID_GATT_CCC expands to a compound literal whose lifetime ends when
 * the enclosing function returns.  Storing that pointer in the client struct
 * from nus_client_init() yields a dangling pointer by the time discovery
 * runs in mtu_exchange_cb.  A static variable avoids this entirely.
 */
static const struct bt_uuid_16 uuid_ccc = BT_UUID_INIT_16(BT_UUID_GATT_CCC_VAL);

/*
 * Per-player BLE client state
 */
struct mobile_client {
    const char* name;

    struct bt_conn* conn;
    bool connecting;
    bool subscribed;

    struct bt_uuid_128 uuid;

    struct bt_gatt_discover_params discover_params;
    struct bt_gatt_subscribe_params subscribe_params;
    struct bt_gatt_exchange_params mtu_exchange_params;

    uint16_t nus_service_end_handle;
};

static struct mobile_client clients[NUM_MOBILE_NODES]; 

static void start_scan(void);
static void begin_discovery(struct mobile_client *client);

// Finds which player owns a BLE connection
static struct mobile_client* find_client_by_conn(struct bt_conn* conn) {
    for (int i = 0; i < NUM_MOBILE_NODES; i++) {
        if (clients[i].conn == conn) {
            return &clients[i];
        }
    }

    return NULL; 
}

/* 
 * Returns true if at least one target player is not currently connected
 * or connecting.
 *
 * Used to decide whether scanning still needs to continue. 
 */
static bool any_client_available(void) {
    for (int i = 0; i < NUM_MOBILE_NODES; i++) {
        if (clients[i].conn == NULL && !clients[i].connecting) {
            return true; 
        }
    }
    return false; 
}

/* 
 * Returns true if at least one target player is not currently connected
 * or connecting.
 * 
 * Used to avoid unnecessary scanning once both players are handled
 */
static bool all_clients_connected(void) {
    for (int i = 0; i < NUM_MOBILE_NODES; i++) {
        if (clients[i].conn == NULL) {
            return false; 
        }
    }

    return true; 
}

/*
 * Helper context used while parsing advertisement data to match the mobile
 * node by advertised name. 
 * 
 * Stores which target player name was matched
 *  0 -> P1
 *  1 -> P2
 *  -1 -> no match
 */
struct name_match_ctx {
    int index;
};

/*
 * Parse advertisement data looking for the device name and compare it to the
 * configured mobile-node name.
 */
static bool ad_parse_name_cb(struct bt_data *data, void *user_data)
{
    struct name_match_ctx *ctx = user_data;

    if (!ctx) {
        return false;
    }

    if (data->type == BT_DATA_NAME_COMPLETE || data->type == BT_DATA_NAME_SHORTENED) {
        char name_buf[32];
        size_t copy_len = data->data_len;

        if (copy_len >= sizeof(name_buf)) {
            copy_len = sizeof(name_buf) - 1;
        }

        memcpy(name_buf, data->data, copy_len);
        name_buf[copy_len] = '\0';

        for (int i = 0; i < NUM_MOBILE_NODES; i++) {
            if (strcmp(name_buf, clients[i].name) == 0) {
                ctx->index = i;
                return false;
            }
        }
        
    }

    return true;
}

/*
 * Notification callback.
 *
 * Once subscribed to the mobile node's NUS TX characteristic, all incoming
 * payload bytes arrive here.
 */
static uint8_t notify_func(struct bt_conn *conn,
                           struct bt_gatt_subscribe_params *params,
                           const void *data, uint16_t length)
{
    if (!data) {
        json_emit_status("nus_notify", "unsubscribed");
        params->value_handle = 0U;
        return BT_GATT_ITER_STOP;
    }

    struct mobile_client* client = find_client_by_conn(conn);

    if (!client) {
        json_emit_status("nus_notify_error", "unknown connection");
        return BT_GATT_ITER_CONTINUE;
    }

    if (length != sizeof(struct imu_packet)) {
        json_emit_status("imu_packet_error", "unexpected payload length");
        return BT_GATT_ITER_CONTINUE;
    }

    const struct imu_packet* pkt = (const struct imu_packet*)data; 

    if (!mobile_link_process_imu_packet(client->name, pkt, length)) {
        json_emit_status("imu_packet_error", "processing failed");
    }

    return BT_GATT_ITER_CONTINUE;
}

/*
 * GATT discovery callback.
 *
 * Stages:
 *   1. discover NUS primary service
 *   2. discover NUS TX characteristic
 *   3. discover CCC descriptor for the TX characteristic
 *   4. subscribe to notifications
 */
static uint8_t discover_func(struct bt_conn *conn, const struct bt_gatt_attr *attr,
                             struct bt_gatt_discover_params *params)
{
    int err;
    struct mobile_client* client = find_client_by_conn(conn);

    if (!client) {
        return BT_GATT_ITER_STOP;
    }

    if (!attr) {
        /* Discovery ended without finding what it was looking for.
         * Report the stage so the failure is visible on serial. */
        if (params->type == BT_GATT_DISCOVER_PRIMARY) {
            json_emit_status("nus_discovery_error", "NUS service not found on peripheral");
        } else if (params->type == BT_GATT_DISCOVER_CHARACTERISTIC) {
            json_emit_status("nus_discovery_error", "NUS TX characteristic not found");
        } else {
            json_emit_status("nus_discovery_error", "NUS CCC descriptor not found");
        }
        (void)memset(params, 0, sizeof(*params));
        return BT_GATT_ITER_STOP;
    }

    if (!bt_uuid_cmp(client->discover_params.uuid, BT_UUID_NUS_SERVICE)) {
        const struct bt_gatt_service_val *service = attr->user_data;

        client->nus_service_end_handle = service->end_handle;

        memcpy(&client->uuid, BT_UUID_NUS_TX, sizeof(client->uuid));
        client->discover_params.uuid = &client->uuid.uuid;
        client->discover_params.start_handle = attr->handle + 1U;
        client->discover_params.end_handle = service->end_handle;
        client->discover_params.type = BT_GATT_DISCOVER_CHARACTERISTIC;

        err = bt_gatt_discover(conn, &client->discover_params);
        if (err) {
            json_emit_status("nus_discovery_error", "TX characteristic discovery failed");
        }

        return BT_GATT_ITER_STOP;
    }

    if (!bt_uuid_cmp(client->discover_params.uuid, BT_UUID_NUS_TX)) {
        const struct bt_gatt_chrc *chrc = attr->user_data;

        client->discover_params.uuid = &uuid_ccc.uuid;
        client->discover_params.start_handle = chrc->value_handle + 1U;
        client->discover_params.end_handle = client->nus_service_end_handle;
        client->discover_params.type = BT_GATT_DISCOVER_DESCRIPTOR;

        client->subscribe_params.value_handle = chrc->value_handle;

        err = bt_gatt_discover(conn, &client->discover_params);
        if (err) {
            json_emit_status("nus_discovery_error", "CCC discovery failed");
        }

        return BT_GATT_ITER_STOP;
    }

    if (!bt_uuid_cmp(attr->uuid, BT_UUID_GATT_CCC)) {
        client->subscribe_params.notify = notify_func;
        client->subscribe_params.value = BT_GATT_CCC_NOTIFY;
        client->subscribe_params.ccc_handle = attr->handle;

        err = bt_gatt_subscribe(conn, &client->subscribe_params);
        if (err && err != -EALREADY) {
            json_emit_status("nus_subscribe_error", "failed to subscribe");
        } else {
            client->subscribed = true; 
            json_emit_status("nus_subscribe", "notifications enabled");

            if (any_client_available()) {
                start_scan();
            }
        }

        return BT_GATT_ITER_STOP;
    }

    /* Non-CCC descriptor encountered during descriptor scan — keep going. */
    return BT_GATT_ITER_CONTINUE;
}

/*
 * MTU exchange callback.
 *
 * GATT discovery is started here rather than in connected() because the ATT
 * layer only allows one outstanding procedure per connection.  Calling
 * bt_gatt_discover while bt_gatt_exchange_mtu is still pending returns
 * -EBUSY and the discovery callback never fires, so notifications are
 * never enabled.  Sequencing discovery after MTU completion avoids this.
 */
static void mtu_exchange_cb(struct bt_conn *conn, uint8_t err,
                            struct bt_gatt_exchange_params *params)
{
    ARG_UNUSED(params);

    struct mobile_client* client = find_client_by_conn(conn);

    printk("%s: MTU exchange %s (%u)\n",
           client ? client->name : "unknown",
           err == 0U ? "successful" : "failed",
           bt_gatt_get_mtu(conn));

    if (client) {
        begin_discovery(client);
    }
}

/*
 * Request an MTU exchange after connection.
 */
static int mtu_exchange(struct mobile_client *client)
{
    int err;

    if (!client || !client->conn) {
        return -EINVAL;
    }

    //printk("%s: Current MTU = %u\n", __func__, bt_gatt_get_mtu(conn));
    
    
    err = bt_gatt_exchange_mtu(client->conn, &client->mtu_exchange_params);
    if (err) {
        printk("%s: MTU exchange failed (err %d)\n", __func__, err);
    }

    return err;
}

// Starts NUS service discovery for specific connected player
static void begin_discovery(struct mobile_client* client) {
    if (!client || !client->conn) {
        return;
    }

    memcpy(&client->uuid, BT_UUID_NUS_SERVICE, sizeof(client->uuid));
    client->discover_params.uuid = &client->uuid.uuid;
    client->discover_params.func = discover_func;
    client->discover_params.start_handle = BT_ATT_FIRST_ATTRIBUTE_HANDLE;
    client->discover_params.end_handle = BT_ATT_LAST_ATTRIBUTE_HANDLE;
    client->discover_params.type = BT_GATT_DISCOVER_PRIMARY;

    int err = bt_gatt_discover(client->conn, &client->discover_params);
    if (err) {
        printk("Discover failed (err %d)\n", err);
    }
}

/*
 * Scan callback used while searching for the mobile node.
 *
 * This process:
 *   - ignores if already connected
 *   - only considers connectable advertisements
 *   - identifies the target device
 *   - stops scanning
 *   - initiates a connection
 */
static void device_found(const bt_addr_le_t *addr, int8_t rssi, uint8_t type,
                         struct net_buf_simple *ad)
{
    char addr_str[BT_ADDR_LE_STR_LEN];
    int err;

    if (!any_client_available()) {
        return;
    }

    if (type != BT_GAP_ADV_TYPE_ADV_IND &&
        type != BT_GAP_ADV_TYPE_ADV_DIRECT_IND) {
        return;
    }

    struct name_match_ctx ctx = {
        .index = -1
    };

    bt_data_parse(ad, ad_parse_name_cb, &ctx);

    if (ctx.index < 0) {
        return;
    }

    struct mobile_client* client = &clients[ctx.index];

    if (client->conn || client->connecting) {
        return;
    }

    bt_addr_le_to_str(addr, addr_str, sizeof(addr_str));
    printk("Mobile node found: %s (RSSI %d)\n", client->name, rssi);

    /*if (bt_le_scan_stop()) {
        return;
    }*/
    (void)bt_le_scan_stop(); 

    client->connecting = true; 

    err = bt_conn_le_create(addr, BT_CONN_LE_CREATE_CONN,
                            BT_LE_CONN_PARAM_DEFAULT, &client->conn);
    if (err) {
        client->connecting = false;
        client->conn = NULL;
        printk("Create conn to %s failed (%d)\n", addr_str, err);
        start_scan();
    } else {
        json_emit_status("nus_connect", "connection initiated");
    }
}

/*
 * Start passive scanning for the mobile node.
 */
static void start_scan(void)
{
    int err;

    if (all_clients_connected()) {
        json_emit_status("nus_scan", "all target mobiles handled");
        return; 
    }

    err = bt_le_scan_start(BT_LE_SCAN_PASSIVE, device_found);
    if (err && err != -EALREADY) {
        printk("Scanning failed to start (err %d)\n", err);
        return;
    }

    json_emit_status("nus_scan", "scanning for PROMETHEUS-P1/P2");
}

/*
 * Connection callback.
 *
 * On successful connection:
 *   - print and emit status
 *   - begin NUS service discovery
 *
 * On failure:
 *   - release connection reference
 *   - restart scanning
 */
static void connected(struct bt_conn *conn, uint8_t err) {
    //char addr[BT_ADDR_LE_STR_LEN];

    //bt_addr_le_to_str(bt_conn_get_dst(conn), addr, sizeof(addr));

    struct mobile_client* client = find_client_by_conn(conn); 

    if (!client) {
        return; 
    }

    client->connecting = false;

    if (err) {
        printk("Failed to connect to %s %u %s\n",
               client->name, err, bt_hci_err_to_str(err));

        bt_conn_unref(client->conn);
        client->conn = NULL;
        client->subscribed = false; 

        start_scan();
        return;
    }

    printk("Connected: %s\n", client->name);
    json_emit_status("nus_connect", "connected to mobile node");

    int parameter_err = bt_conn_le_param_update(conn, &fast_conn_params); 
    if (parameter_err) {
        printk("Connection parameter update failed: %d\n", parameter_err);
    }

    /* MTU exchange first; discovery is triggered from mtu_exchange_cb. */
    (void)mtu_exchange(client);

    /* Scan for the other player immediately rather than waiting for this
     * player's subscription to complete — both can proceed in parallel. */
    if (any_client_available()) {
        start_scan();
    }
}

/*
 * Disconnection callback.
 *
 * When the mobile node disconnects, release the connection reference and
 * restart scanning so the base can reconnect automatically.
 */
static void disconnected(struct bt_conn *conn, uint8_t reason)
{
    char addr[BT_ADDR_LE_STR_LEN];

    struct mobile_client* client = find_client_by_conn(conn);

    if (!client) {
        return;
    }

    bt_addr_le_to_str(bt_conn_get_dst(conn), addr, sizeof(addr));
    printk("Disconnected: %s, reason 0x%02x %s\n",
           addr, reason, bt_hci_err_to_str(reason));

    bt_conn_unref(client->conn);
    client->conn = NULL;
    client->connecting = false;
    client->subscribed = false;
    client->nus_service_end_handle = 0; 

    memset(&client->discover_params, 0, sizeof(client->discover_params));
    memset(&client->subscribe_params, 0, sizeof(client->subscribe_params));


    json_emit_status("nus_connect", "disconnected from mobile node");
    start_scan();
}

BT_CONN_CB_DEFINE(conn_callbacks) = {
    .connected = connected,
    .disconnected = disconnected,
};

/*
 * Initialise local client state.
 */
void nus_client_init(void)
{

    for (int i = 0; i < NUM_MOBILE_NODES; i++) {
        clients[i].name = mobile_names[i];
        clients[i].conn = NULL;
        clients[i].connecting = false; 
        clients[i].subscribed = false;
        clients[i].nus_service_end_handle = 0;

        memset(&clients[i].uuid, 0, sizeof(clients[i].uuid));
        memset(&clients[i].discover_params, 0, sizeof(clients[i].discover_params));
        memset(&clients[i].subscribe_params, 0, sizeof(clients[i].subscribe_params));
        memset(&clients[i].mtu_exchange_params, 0, sizeof(clients[i].mtu_exchange_params));

        clients[i].mtu_exchange_params.func = mtu_exchange_cb;
    }
    
}

/*
 * Start the BLE central/client workflow.
 */
bool nus_client_start(void)
{
    start_scan();
    return true;
}
```

## src/nus_client.h
```c
#ifndef NUS_CLIENT_H
#define NUS_CLIENT_H

#include <stdbool.h>

void nus_client_init(void);
bool nus_client_start(void);

#endif /* NUS_CLIENT_H */
```

## src/serial_audio.c
```c
#include "serial_audio.h"
#include "audio_out.h"
#include "json_serial.h"
#include "ui_display.h"

#include <zephyr/device.h>
#include <zephyr/drivers/uart.h>
#include <zephyr/kernel.h>

#include <string.h>
#include <stdint.h>
#include <stddef.h>
#include <stdlib.h>

#define RX_BUF_SIZE 128
#define LINE_BUF_SIZE 128
#define SERIAL_AUDIO_STACK_SIZE 2048
#define SERIAL_AUDIO_PRIORITY 7

static const struct device *uart_dev = DEVICE_DT_GET(DT_CHOSEN(zephyr_console));
static char rx_buf[RX_BUF_SIZE];
static char line_buf[LINE_BUF_SIZE];
static size_t rx_len;
static K_SEM_DEFINE(line_ready_sem, 0, 1);

void serial_processing_thread(void *a, void *b, void *c);
K_THREAD_DEFINE(serial_audio_tid,
                SERIAL_AUDIO_STACK_SIZE,
                serial_processing_thread,
                NULL, NULL, NULL,
                SERIAL_AUDIO_PRIORITY,
                0,
                0);
				

/*
 * Parse JSON packets from the PC backend.
 *
 * Supported packets:
 *     {"type":"score","p1":1,"p2":0,"high":4}
 *     {"type":"gesture","gesture":"START"}
 *     {"type":"audio","event":"eagle_killed"}
 */
static void process_line(const char *line) {
	if (!line) {
		return;
	}

	// Process score json packets
	if (strstr(line, "\"type\":\"score\"") != NULL ||
    strstr(line, "\"type\": \"score\"") != NULL) {

		int p1 = 0;
		int p2 = 0;
		int high = 0;

		char* p;

		p = strstr(line, "\"p1\":");
		if (p) {
			p1 = atoi(p + 5);
		}

		p = strstr(line, "\"p2\":");
		if (p) {
			p2 = atoi(p + 5);
		}

		p = strstr(line, "\"high\":");
		if (p) {
			high = atoi(p + 7);
		}

		ui_display_update_score(p1, p2, high);
		return;
	}

	// Process winner json packets
	if (strstr(line, "\"type\":\"winner\"") != NULL ||
    	strstr(line, "\"type\": \"winner\"") != NULL) {

		if (strstr(line, "P1")) {
			ui_display_update_winner("P1");
		} else if (strstr(line, "P2")) {
			ui_display_update_winner("P2");
		} else {
			ui_display_update_winner("NONE");
		}

    	return;
	}

	// Process gesture packets
	if (strstr(line, "\"type\":\"gesture\"") != NULL ||
		strstr(line, "\"type\": \"gesture\"") != NULL) {

		if (strstr(line, "START")) {
			ui_display_update_gesture("START");
		} else if (strstr(line, "PAUSE")) {
			ui_display_update_gesture("PAUSE");
		} else if (strstr(line, "RESTART")) {
			ui_display_update_gesture("RESTART");
		} else {
			ui_display_update_gesture("NONE");
		}

		return;
	}

	// Process audio json packets
	if (strstr(line, "\"type\":\"audio\"") == NULL &&
	    strstr(line, "\"type\": \"audio\"") == NULL) {
		return;
	}

	// Process event json packets 
	if (strstr(line, "eagle_killed") != NULL) {
		ui_display_update_audio("eagle_killed");
		audio_out_queue_event("eagle_killed");
	} else if (strstr(line, "game_over") != NULL) {
		ui_display_update_audio("game_over");
		audio_out_queue_event("game_over");
	} else if (strstr(line, "ready") != NULL) {
    	ui_display_update_audio("ready"); 
	} else {
		json_emit_status("audio_rx", "unknown audio event");
	}
}

/*
 * UART ISR callback.
 *
 * Reads bytes from UART FIFO and constructs newline-terminated messages.
 */
static void uart_cb(const struct device *dev, void *user_data) {
	ARG_UNUSED(user_data);

	while (uart_irq_update(dev) && uart_irq_is_pending(dev)) {
		if (!uart_irq_rx_ready(dev)) {
			continue;
		}

		uint8_t ch;

		while (uart_fifo_read(dev, &ch, 1) == 1) {
			if (ch == '\r') {
				continue;
			}

			if (ch == '\n') {
				rx_buf[rx_len] = '\0';
				memcpy(line_buf, rx_buf, rx_len + 1);
                rx_len = 0;
                k_sem_give(&line_ready_sem);
                continue;
			}

			if (rx_len < sizeof(rx_buf) - 1) {
				rx_buf[rx_len++] = (char)ch;
			} else {
				rx_len = 0;
			}
		}
	}
}

/*
 * Initialise UART receive interrupt handling.
 */
void serial_init(void)
{
	if (!device_is_ready(uart_dev)) {
		json_emit_status("serial", "uart not ready");
		return;
	}

	rx_len = 0;

	uart_irq_callback_user_data_set(uart_dev, uart_cb, NULL);
	uart_irq_rx_enable(uart_dev);

	json_emit_status("serial", "ready for audio commands");
}

/*
 * Thread that processes complete UART lines queued by uart_cb().
 */
void serial_processing_thread(void *a, void *b, void *c) {
    while (1) {
		// Takes semaphore for line ready; then processes line
        k_sem_take(&line_ready_sem, K_FOREVER);
        process_line(line_buf);
    }
}
```

## src/serial_audio.h
```c
#ifndef SERIAL_AUDIO_H
#define SERIAL_AUDIO_H

void serial_init(void);

#endif
```

## src/ui_display.c
```c
#include "ui_display.h"
#include "json_serial.h"

#include <zephyr/kernel.h>
#include <zephyr/sys/printk.h>
#include <lvgl.h>
#include <stdio.h>
#include <math.h>
#include <zephyr/drivers/gpio.h>
#include <zephyr/drivers/display.h>

#define LCD_PWR_NODE DT_ALIAS(led0)

static lv_obj_t *label_title;
static lv_obj_t *label_p1;
static lv_obj_t *label_p2;
static lv_obj_t *label_audio;
static lv_obj_t *label_p1_score;
static lv_obj_t *label_p2_score;
static lv_obj_t *label_high_score;
static lv_obj_t *label_winner;
static lv_obj_t *label_gesture;

/*
 * Initialise LVGL objects on the M5Core2 screen.
 *
 * Layout:
 *   Left column  = IMU, gesture, audio status
 *   Right column = scores
 */
void ui_display_init(void) {

    const struct device *display = DEVICE_DT_GET(DT_CHOSEN(zephyr_display));

    if (!device_is_ready(display)) {
        printk("DISPLAY NOT READY\n");
        return;
    }

    printk("DISPLAY READY\n");
    display_blanking_off(display);

    lv_obj_t* screen = lv_scr_act();

    // Background 
	lv_obj_set_style_bg_color(screen, lv_color_black(), LV_PART_MAIN);
	lv_obj_set_style_bg_opa(screen, LV_OPA_COVER, LV_PART_MAIN);

    // Title label 
	label_title = lv_label_create(screen);
	lv_label_set_text(label_title, "OXBLOOD PROMETHEUS");
	lv_obj_set_style_text_color(label_title, lv_color_white(), LV_PART_MAIN);
	lv_obj_align(label_title, LV_ALIGN_TOP_MID, 0, 8);

    // Gyroscope labels
	label_p1 = lv_label_create(screen);
	lv_label_set_text(label_p1, "P1 gy: -- gz: --");
	lv_obj_set_style_text_color(label_p1, lv_color_white(), LV_PART_MAIN);
	lv_obj_align(label_p1, LV_ALIGN_TOP_LEFT, 10, 45);

	label_p2 = lv_label_create(screen);
	lv_label_set_text(label_p2, "P2 gy: -- gz: --");
	lv_obj_set_style_text_color(label_p2, lv_color_white(), LV_PART_MAIN);
	lv_obj_align(label_p2, LV_ALIGN_TOP_LEFT, 10, 80);

    // Gesture label
    label_gesture = lv_label_create(screen);
    lv_label_set_text(label_gesture, "Gesture: NONE");
    lv_obj_set_style_text_color(label_gesture, lv_color_white(), LV_PART_MAIN);
    lv_obj_align(label_gesture, LV_ALIGN_TOP_LEFT, 10, 120);

    // Audio labels
	label_audio = lv_label_create(screen);
	lv_label_set_text(label_audio, "Audio: READY");
	lv_obj_set_style_text_color(label_audio, lv_color_white(), LV_PART_MAIN);
	lv_obj_align(label_audio, LV_ALIGN_TOP_LEFT, 10, 155);

    // Score labels
	label_p1_score = lv_label_create(screen);
    lv_label_set_text(label_p1_score, "P1 Score: 0");
    lv_obj_set_style_text_color(label_p1_score, lv_color_white(), LV_PART_MAIN);
    lv_obj_align(label_p1_score, LV_ALIGN_TOP_LEFT, 190, 45);

    label_p2_score = lv_label_create(screen);
    lv_label_set_text(label_p2_score, "P2 Score: 0");
    lv_obj_set_style_text_color(label_p2_score, lv_color_white(), LV_PART_MAIN);
    lv_obj_align(label_p2_score, LV_ALIGN_TOP_LEFT, 190, 80);

    label_winner = lv_label_create(screen);
    lv_label_set_text(label_winner, "Winner: NONE");
    lv_obj_set_style_text_color(label_winner, lv_color_white(), LV_PART_MAIN);
    lv_obj_align(label_winner, LV_ALIGN_TOP_LEFT, 190, 120);

    label_high_score = lv_label_create(screen);
    lv_label_set_text(label_high_score, "High Score: 0");
    lv_obj_set_style_text_color(label_high_score, lv_color_white(), LV_PART_MAIN);
    lv_obj_align(label_high_score, LV_ALIGN_TOP_LEFT, 190, 155);

    for (int i = 0; i < 10; i++) {
        lv_timer_handler();
        k_msleep(20);
    }

    json_emit_status("display", "ready");
}

/*
 * Update one player's gyro telemetry.
 */
void ui_display_update_imu(int player, float gy, float gz) {
	char buf[64];

	snprintf(buf, sizeof(buf), "P%d gy: %5.1f gz: %5.1f", player, 
                (double)gy, (double)gz);

	if (player == 1 && label_p1) {
		lv_label_set_text(label_p1, buf);
	} else if (player == 2 && label_p2) {
		lv_label_set_text(label_p2, buf);
	}
}

/*
 * Update player scores and high score. 
 */
void ui_display_update_score(int p1_score, int p2_score, int high_score) {
	char buf[64];

	snprintf(buf, sizeof(buf), "P1 Score: %d", p1_score);

	if (label_p1_score) {
		lv_label_set_text(label_p1_score, buf);
	}

	snprintf(buf, sizeof(buf), "P2 Score: %d", p2_score);

	if (label_p2_score) {
		lv_label_set_text(label_p2_score, buf);
	}

	snprintf(buf, sizeof(buf), "High Score: %d", high_score);

	if (label_high_score) {
		lv_label_set_text(label_high_score, buf);
	}
}

/*
 * Update winner label. 
 */
void ui_display_update_winner(const char *winner) {
    char buf[64];

    snprintf(buf, sizeof(buf), "Winner: %s", winner ? winner : "NONE");

    if (label_winner) {
        lv_label_set_text(label_winner, buf);
    }
}

/*
 * Update audio status label
 */
void ui_display_update_audio(const char *event) {
	char buf[64];

	snprintf(buf, sizeof(buf), "Audio: %s", event ? event : "unknown");

	if (label_audio) {
		lv_label_set_text(label_audio, buf);
	}
}

/*
 * Update detected gesture label. 
 */
void ui_display_update_gesture(const char *gesture) {
    char buf[64];

    snprintf(buf,
             sizeof(buf),
             "Gesture: %s",
             gesture ? gesture : "NONE");

    if (label_gesture) {
        lv_label_set_text(label_gesture, buf);
    }
}

/*
 * Called periodically from main loop to refesh LVGL objects
 */
void ui_display_tick(void) {
	lv_timer_handler();
}
```
